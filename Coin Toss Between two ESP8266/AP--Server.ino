#include <ESP8266WiFi.h>   //for TCP Connection
#include <ESP8266WebServer.h>  //for creating Server on ESP Board
#include <ArduinoJson.h>   // to get JSON String
#include<WiFiClient.h>


const char* ssid = "Your SSID";
const char* password = "Your Password";

WiFiServer server(80);

void setup(){
  // Serial port for debugging purposes
  Serial.begin(9600);
  Serial.println();
  
  // Setting the ESP as an access point
  Serial.print("Setting AP (Access Point)…");
  // Remove the password parameter, if you want the AP (Access Point) to be open
  WiFi.mode(WIFI_AP);
  WiFi.softAP(ssid, password);

  IPAddress IP = WiFi.softAPIP();  //Obtaining IP Address
  Serial.print("AP IP address: ");
  Serial.println(IP);  

  // Start server
  server.begin();
}

void loop(){
  // listen for incoming clients
  WiFiClient client = server.available();
  if (client && client.connected()) {
     // Coin Toss function to randomly select a device
    int rand_data = rand() % 2;                 //Generating Random int data between 0 and 1
    client.print((String)rand_data + "\n");     // Sending the generated data to the other device
    String compare_data = client.readStringUntil('\n');           //Receiving the random int generated by the other device
    Serial.println("Data_recieved = " + (String)compare_data);    // Printing the data received from the other deivce to serial monitor
    
    if(rand_data > compare_data.toInt()) {            // When we win the toss
      Serial.println("YESS");                            //Prints Yes to the serial monitor, means this device won
      client.print("This !");                            // Sends a string called "This" to the other device, There was no real use I was just experimenting
      }
    else if(rand_data == compare_data.toInt()) {
      Serial.println("Both EQUAL");
      }
    else {  
      String compare =  client.readStringUntil('!');        // Revieveing the "This" string from the other device if we lose
      Serial.println(compare);                               // Prints "This" to make sure we recieved it
      Serial.println("NOO");                               // Prints noo to serial monitor means this device lost
      } 
      client.stop();                                      //Need to stop the client only once

                                                   
  }
}
